// Autogenerated with StateSmith 0.9.12-alpha.
// Algorithm: Balanced1. See https://github.com/StateSmith/StateSmith/wiki/Algorithms

#include "LightSm.h"
#include <stdbool.h> // required for `consume_event` flag
#include <string.h> // for memset

// This function is used when StateSmith doesn't know what the active leaf state is at
// compile time due to sub states or when multiple states need to be exited.
static void exit_up_to_state_handler(LightSm* sm, LightSm_Func desired_state_exit_handler);

static void ROOT_enter(LightSm* sm);

static void ROOT_exit(LightSm* sm);

static void FAST_REVERSE_enter(LightSm* sm);

static void FAST_REVERSE_exit(LightSm* sm);

static void R1_enter(LightSm* sm);

static void R1_exit(LightSm* sm);

static void R1_do(LightSm* sm);

static void R2_enter(LightSm* sm);

static void R2_exit(LightSm* sm);

static void R2_do(LightSm* sm);

static void R3_enter(LightSm* sm);

static void R3_exit(LightSm* sm);

static void R3_do(LightSm* sm);

static void NORMAL_enter(LightSm* sm);

static void NORMAL_exit(LightSm* sm);

static void NORMAL_key_press(LightSm* sm);

static void NORMAL_InitialState_transition(LightSm* sm);

static void OFF_enter(LightSm* sm);

static void OFF_exit(LightSm* sm);

static void OFF_do(LightSm* sm);

static void ON1_enter(LightSm* sm);

static void ON1_exit(LightSm* sm);

static void ON1_do(LightSm* sm);

static void ON2_enter(LightSm* sm);

static void ON2_exit(LightSm* sm);

static void ON2_do(LightSm* sm);

static void ON3_enter(LightSm* sm);

static void ON3_exit(LightSm* sm);

static void ON3_do(LightSm* sm);


// State machine constructor. Must be called before start or dispatch event functions. Not thread safe.
void LightSm_ctor(LightSm* sm)
{
    memset(sm, 0, sizeof(*sm));
}

// Starts the state machine. Must be called before dispatching events. Not thread safe.
void LightSm_start(LightSm* sm)
{
    ROOT_enter(sm);
    // ROOT behavior
    // uml: TransitionTo(ROOT.<InitialState>)
    {
        // Step 1: Exit states until we reach `ROOT` state (Least Common Ancestor for transition). Already at LCA, no exiting required.
        
        // Step 2: Transition action: ``.
        
        // Step 3: Enter/move towards transition target `ROOT.<InitialState>`.
        // ROOT.<InitialState> is a pseudo state and cannot have an `enter` trigger.
        
        // ROOT.<InitialState> behavior
        // uml: TransitionTo(NORMAL)
        {
            // Step 1: Exit states until we reach `ROOT` state (Least Common Ancestor for transition). Already at LCA, no exiting required.
            
            // Step 2: Transition action: ``.
            
            // Step 3: Enter/move towards transition target `NORMAL`.
            NORMAL_enter(sm);
            
            // Finish transition by calling pseudo state transition function.
            NORMAL_InitialState_transition(sm);
            return; // event processing immediately stops when a transition finishes. No other behaviors for this state are checked.
        } // end of behavior for ROOT.<InitialState>
    } // end of behavior for ROOT
}

// Dispatches an event to the state machine. Not thread safe.
void LightSm_dispatch_event(LightSm* sm, LightSm_EventId event_id)
{
    LightSm_Func behavior_func = sm->current_event_handlers[event_id];
    
    while (behavior_func != NULL)
    {
        sm->ancestor_event_handler = NULL;
        behavior_func(sm);
        behavior_func = sm->ancestor_event_handler;
    }
}

// This function is used when StateSmith doesn't know what the active leaf state is at
// compile time due to sub states or when multiple states need to be exited.
static void exit_up_to_state_handler(LightSm* sm, LightSm_Func desired_state_exit_handler)
{
    while (sm->current_state_exit_handler != desired_state_exit_handler)
    {
        sm->current_state_exit_handler(sm);
    }
}


////////////////////////////////////////////////////////////////////////////////
// event handlers for state ROOT
////////////////////////////////////////////////////////////////////////////////

static void ROOT_enter(LightSm* sm)
{
    // setup trigger/event handlers
    sm->current_state_exit_handler = ROOT_exit;
}

static void ROOT_exit(LightSm* sm)
{
    // State machine root is a special case. It cannot be exited. Mark as unused.
    (void)sm;
}


////////////////////////////////////////////////////////////////////////////////
// event handlers for state FAST_REVERSE
////////////////////////////////////////////////////////////////////////////////

static void FAST_REVERSE_enter(LightSm* sm)
{
    // setup trigger/event handlers
    sm->current_state_exit_handler = FAST_REVERSE_exit;
    
    // FAST_REVERSE behavior
    // uml: enter / { count = 0;\nlight_off(); }
    {
        // Step 1: execute action `count = 0;\nlight_off();`
        count = 0;
        light_off();
    } // end of behavior for FAST_REVERSE
}

static void FAST_REVERSE_exit(LightSm* sm)
{
    // adjust function pointers for this state's exit
    sm->current_state_exit_handler = ROOT_exit;
}


////////////////////////////////////////////////////////////////////////////////
// event handlers for state R1
////////////////////////////////////////////////////////////////////////////////

static void R1_enter(LightSm* sm)
{
    // setup trigger/event handlers
    sm->current_state_exit_handler = R1_exit;
    sm->current_event_handlers[LightSm_EventId_DO] = R1_do;
    
    // R1 behavior
    // uml: enter / { reset_timer(); }
    {
        // Step 1: execute action `reset_timer();`
        reset_timer();
    } // end of behavior for R1
    
    // R1 behavior
    // uml: enter / { light_i(1); }
    {
        // Step 1: execute action `light_i(1);`
        light_i(1);
    } // end of behavior for R1
}

static void R1_exit(LightSm* sm)
{
    // adjust function pointers for this state's exit
    sm->current_state_exit_handler = FAST_REVERSE_exit;
    sm->current_event_handlers[LightSm_EventId_DO] = NULL;  // no ancestor listens to this event
}

static void R1_do(LightSm* sm)
{
    // No ancestor state handles `do` event.
    
    // R1 behavior
    // uml: do [timer() > FAST_TIMEOUT] TransitionTo(FAST_REVERSE.<ChoicePoint>())
    if (timer() > FAST_TIMEOUT)
    {
        // Step 1: Exit states until we reach `FAST_REVERSE` state (Least Common Ancestor for transition).
        R1_exit(sm);
        
        // Step 2: Transition action: ``.
        
        // Step 3: Enter/move towards transition target `FAST_REVERSE.<ChoicePoint>()`.
        // FAST_REVERSE.<ChoicePoint>() is a pseudo state and cannot have an `enter` trigger.
        
        // FAST_REVERSE.<ChoicePoint>() behavior
        // uml: [count >= 3] TransitionTo(NORMAL)
        if (count >= 3)
        {
            // Step 1: Exit states until we reach `ROOT` state (Least Common Ancestor for transition).
            exit_up_to_state_handler(sm, ROOT_exit);
            
            // Step 2: Transition action: ``.
            
            // Step 3: Enter/move towards transition target `NORMAL`.
            NORMAL_enter(sm);
            
            // Finish transition by calling pseudo state transition function.
            NORMAL_InitialState_transition(sm);
            return; // event processing immediately stops when a transition finishes. No other behaviors for this state are checked.
        } // end of behavior for FAST_REVERSE.<ChoicePoint>()
        
        // FAST_REVERSE.<ChoicePoint>() behavior
        // uml: else TransitionTo(R3)
        {
            // Step 1: Exit states until we reach `FAST_REVERSE` state (Least Common Ancestor for transition). Already at LCA, no exiting required.
            
            // Step 2: Transition action: ``.
            
            // Step 3: Enter/move towards transition target `R3`.
            R3_enter(sm);
            
            // Step 4: complete transition. Ends event dispatch. No other behaviors are checked.
            sm->state_id = LightSm_StateId_R3;
            // No ancestor handles event. Can skip nulling `ancestor_event_handler`.
            return;
        } // end of behavior for FAST_REVERSE.<ChoicePoint>()
    } // end of behavior for R1
}


////////////////////////////////////////////////////////////////////////////////
// event handlers for state R2
////////////////////////////////////////////////////////////////////////////////

static void R2_enter(LightSm* sm)
{
    // setup trigger/event handlers
    sm->current_state_exit_handler = R2_exit;
    sm->current_event_handlers[LightSm_EventId_DO] = R2_do;
    
    // R2 behavior
    // uml: enter / { reset_timer(); }
    {
        // Step 1: execute action `reset_timer();`
        reset_timer();
    } // end of behavior for R2
    
    // R2 behavior
    // uml: enter / { light_i(2); }
    {
        // Step 1: execute action `light_i(2);`
        light_i(2);
    } // end of behavior for R2
}

static void R2_exit(LightSm* sm)
{
    // adjust function pointers for this state's exit
    sm->current_state_exit_handler = FAST_REVERSE_exit;
    sm->current_event_handlers[LightSm_EventId_DO] = NULL;  // no ancestor listens to this event
}

static void R2_do(LightSm* sm)
{
    // No ancestor state handles `do` event.
    
    // R2 behavior
    // uml: do [timer() > FAST_TIMEOUT] TransitionTo(R1)
    if (timer() > FAST_TIMEOUT)
    {
        // Step 1: Exit states until we reach `FAST_REVERSE` state (Least Common Ancestor for transition).
        R2_exit(sm);
        
        // Step 2: Transition action: ``.
        
        // Step 3: Enter/move towards transition target `R1`.
        R1_enter(sm);
        
        // Step 4: complete transition. Ends event dispatch. No other behaviors are checked.
        sm->state_id = LightSm_StateId_R1;
        // No ancestor handles event. Can skip nulling `ancestor_event_handler`.
        return;
    } // end of behavior for R2
}


////////////////////////////////////////////////////////////////////////////////
// event handlers for state R3
////////////////////////////////////////////////////////////////////////////////

static void R3_enter(LightSm* sm)
{
    // setup trigger/event handlers
    sm->current_state_exit_handler = R3_exit;
    sm->current_event_handlers[LightSm_EventId_DO] = R3_do;
    
    // R3 behavior
    // uml: enter / { count++; }
    {
        // Step 1: execute action `count++;`
        count++;
    } // end of behavior for R3
    
    // R3 behavior
    // uml: enter / { reset_timer(); }
    {
        // Step 1: execute action `reset_timer();`
        reset_timer();
    } // end of behavior for R3
    
    // R3 behavior
    // uml: enter / { light_i(3); }
    {
        // Step 1: execute action `light_i(3);`
        light_i(3);
    } // end of behavior for R3
}

static void R3_exit(LightSm* sm)
{
    // adjust function pointers for this state's exit
    sm->current_state_exit_handler = FAST_REVERSE_exit;
    sm->current_event_handlers[LightSm_EventId_DO] = NULL;  // no ancestor listens to this event
}

static void R3_do(LightSm* sm)
{
    // No ancestor state handles `do` event.
    
    // R3 behavior
    // uml: do [timer() > FAST_TIMEOUT] TransitionTo(R2)
    if (timer() > FAST_TIMEOUT)
    {
        // Step 1: Exit states until we reach `FAST_REVERSE` state (Least Common Ancestor for transition).
        R3_exit(sm);
        
        // Step 2: Transition action: ``.
        
        // Step 3: Enter/move towards transition target `R2`.
        R2_enter(sm);
        
        // Step 4: complete transition. Ends event dispatch. No other behaviors are checked.
        sm->state_id = LightSm_StateId_R2;
        // No ancestor handles event. Can skip nulling `ancestor_event_handler`.
        return;
    } // end of behavior for R3
}


////////////////////////////////////////////////////////////////////////////////
// event handlers for state NORMAL
////////////////////////////////////////////////////////////////////////////////

static void NORMAL_enter(LightSm* sm)
{
    // setup trigger/event handlers
    sm->current_state_exit_handler = NORMAL_exit;
    sm->current_event_handlers[LightSm_EventId_KEY_PRESS] = NORMAL_key_press;
}

static void NORMAL_exit(LightSm* sm)
{
    // adjust function pointers for this state's exit
    sm->current_state_exit_handler = ROOT_exit;
    sm->current_event_handlers[LightSm_EventId_KEY_PRESS] = NULL;  // no ancestor listens to this event
}

static void NORMAL_key_press(LightSm* sm)
{
    // No ancestor state handles `key_press` event.
    
    // NORMAL behavior
    // uml: KEY_PRESS TransitionTo(FAST_REVERSE)
    {
        // Step 1: Exit states until we reach `ROOT` state (Least Common Ancestor for transition).
        exit_up_to_state_handler(sm, ROOT_exit);
        
        // Step 2: Transition action: ``.
        
        // Step 3: Enter/move towards transition target `FAST_REVERSE`.
        FAST_REVERSE_enter(sm);
        
        // FAST_REVERSE.<InitialState> behavior
        // uml: TransitionTo(R3)
        {
            // Step 1: Exit states until we reach `FAST_REVERSE` state (Least Common Ancestor for transition). Already at LCA, no exiting required.
            
            // Step 2: Transition action: ``.
            
            // Step 3: Enter/move towards transition target `R3`.
            R3_enter(sm);
            
            // Step 4: complete transition. Ends event dispatch. No other behaviors are checked.
            sm->state_id = LightSm_StateId_R3;
            // No ancestor handles event. Can skip nulling `ancestor_event_handler`.
            return;
        } // end of behavior for FAST_REVERSE.<InitialState>
    } // end of behavior for NORMAL
}

static void NORMAL_InitialState_transition(LightSm* sm)
{
    // NORMAL.<InitialState> behavior
    // uml: TransitionTo(OFF)
    {
        // Step 1: Exit states until we reach `NORMAL` state (Least Common Ancestor for transition). Already at LCA, no exiting required.
        
        // Step 2: Transition action: ``.
        
        // Step 3: Enter/move towards transition target `OFF`.
        OFF_enter(sm);
        
        // Step 4: complete transition. Ends event dispatch. No other behaviors are checked.
        sm->state_id = LightSm_StateId_OFF;
        sm->ancestor_event_handler = NULL;
        return;
    } // end of behavior for NORMAL.<InitialState>
}


////////////////////////////////////////////////////////////////////////////////
// event handlers for state OFF
////////////////////////////////////////////////////////////////////////////////

static void OFF_enter(LightSm* sm)
{
    // setup trigger/event handlers
    sm->current_state_exit_handler = OFF_exit;
    sm->current_event_handlers[LightSm_EventId_DO] = OFF_do;
    
    // OFF behavior
    // uml: enter / { reset_timer(); }
    {
        // Step 1: execute action `reset_timer();`
        reset_timer();
    } // end of behavior for OFF
    
    // OFF behavior
    // uml: enter / { light_off(); }
    {
        // Step 1: execute action `light_off();`
        light_off();
    } // end of behavior for OFF
}

static void OFF_exit(LightSm* sm)
{
    // adjust function pointers for this state's exit
    sm->current_state_exit_handler = NORMAL_exit;
    sm->current_event_handlers[LightSm_EventId_DO] = NULL;  // no ancestor listens to this event
}

static void OFF_do(LightSm* sm)
{
    // No ancestor state handles `do` event.
    
    // OFF behavior
    // uml: do [timer() > TIMEOUT] TransitionTo(ON1)
    if (timer() > TIMEOUT)
    {
        // Step 1: Exit states until we reach `NORMAL` state (Least Common Ancestor for transition).
        OFF_exit(sm);
        
        // Step 2: Transition action: ``.
        
        // Step 3: Enter/move towards transition target `ON1`.
        ON1_enter(sm);
        
        // Step 4: complete transition. Ends event dispatch. No other behaviors are checked.
        sm->state_id = LightSm_StateId_ON1;
        // No ancestor handles event. Can skip nulling `ancestor_event_handler`.
        return;
    } // end of behavior for OFF
}


////////////////////////////////////////////////////////////////////////////////
// event handlers for state ON1
////////////////////////////////////////////////////////////////////////////////

static void ON1_enter(LightSm* sm)
{
    // setup trigger/event handlers
    sm->current_state_exit_handler = ON1_exit;
    sm->current_event_handlers[LightSm_EventId_DO] = ON1_do;
    
    // ON1 behavior
    // uml: enter / { reset_timer(); }
    {
        // Step 1: execute action `reset_timer();`
        reset_timer();
    } // end of behavior for ON1
    
    // ON1 behavior
    // uml: enter / { light_1(); }
    {
        // Step 1: execute action `light_1();`
        light_1();
    } // end of behavior for ON1
}

static void ON1_exit(LightSm* sm)
{
    // adjust function pointers for this state's exit
    sm->current_state_exit_handler = NORMAL_exit;
    sm->current_event_handlers[LightSm_EventId_DO] = NULL;  // no ancestor listens to this event
}

static void ON1_do(LightSm* sm)
{
    // No ancestor state handles `do` event.
    
    // ON1 behavior
    // uml: do [timer() > TIMEOUT] TransitionTo(ON2)
    if (timer() > TIMEOUT)
    {
        // Step 1: Exit states until we reach `NORMAL` state (Least Common Ancestor for transition).
        ON1_exit(sm);
        
        // Step 2: Transition action: ``.
        
        // Step 3: Enter/move towards transition target `ON2`.
        ON2_enter(sm);
        
        // Step 4: complete transition. Ends event dispatch. No other behaviors are checked.
        sm->state_id = LightSm_StateId_ON2;
        // No ancestor handles event. Can skip nulling `ancestor_event_handler`.
        return;
    } // end of behavior for ON1
}


////////////////////////////////////////////////////////////////////////////////
// event handlers for state ON2
////////////////////////////////////////////////////////////////////////////////

static void ON2_enter(LightSm* sm)
{
    // setup trigger/event handlers
    sm->current_state_exit_handler = ON2_exit;
    sm->current_event_handlers[LightSm_EventId_DO] = ON2_do;
    
    // ON2 behavior
    // uml: enter / { reset_timer(); }
    {
        // Step 1: execute action `reset_timer();`
        reset_timer();
    } // end of behavior for ON2
    
    // ON2 behavior
    // uml: enter / { light_12(); }
    {
        // Step 1: execute action `light_12();`
        light_12();
    } // end of behavior for ON2
}

static void ON2_exit(LightSm* sm)
{
    // adjust function pointers for this state's exit
    sm->current_state_exit_handler = NORMAL_exit;
    sm->current_event_handlers[LightSm_EventId_DO] = NULL;  // no ancestor listens to this event
}

static void ON2_do(LightSm* sm)
{
    // No ancestor state handles `do` event.
    
    // ON2 behavior
    // uml: do [timer() > TIMEOUT] TransitionTo(ON3)
    if (timer() > TIMEOUT)
    {
        // Step 1: Exit states until we reach `NORMAL` state (Least Common Ancestor for transition).
        ON2_exit(sm);
        
        // Step 2: Transition action: ``.
        
        // Step 3: Enter/move towards transition target `ON3`.
        ON3_enter(sm);
        
        // Step 4: complete transition. Ends event dispatch. No other behaviors are checked.
        sm->state_id = LightSm_StateId_ON3;
        // No ancestor handles event. Can skip nulling `ancestor_event_handler`.
        return;
    } // end of behavior for ON2
}


////////////////////////////////////////////////////////////////////////////////
// event handlers for state ON3
////////////////////////////////////////////////////////////////////////////////

static void ON3_enter(LightSm* sm)
{
    // setup trigger/event handlers
    sm->current_state_exit_handler = ON3_exit;
    sm->current_event_handlers[LightSm_EventId_DO] = ON3_do;
    
    // ON3 behavior
    // uml: enter / { reset_timer(); }
    {
        // Step 1: execute action `reset_timer();`
        reset_timer();
    } // end of behavior for ON3
    
    // ON3 behavior
    // uml: enter / { light_123(); }
    {
        // Step 1: execute action `light_123();`
        light_123();
    } // end of behavior for ON3
}

static void ON3_exit(LightSm* sm)
{
    // adjust function pointers for this state's exit
    sm->current_state_exit_handler = NORMAL_exit;
    sm->current_event_handlers[LightSm_EventId_DO] = NULL;  // no ancestor listens to this event
}

static void ON3_do(LightSm* sm)
{
    // No ancestor state handles `do` event.
    
    // ON3 behavior
    // uml: do [timer() > 2 * TIMEOUT] TransitionTo(OFF)
    if (timer() > 2 * TIMEOUT)
    {
        // Step 1: Exit states until we reach `NORMAL` state (Least Common Ancestor for transition).
        ON3_exit(sm);
        
        // Step 2: Transition action: ``.
        
        // Step 3: Enter/move towards transition target `OFF`.
        OFF_enter(sm);
        
        // Step 4: complete transition. Ends event dispatch. No other behaviors are checked.
        sm->state_id = LightSm_StateId_OFF;
        // No ancestor handles event. Can skip nulling `ancestor_event_handler`.
        return;
    } // end of behavior for ON3
}

// Thread safe.
char const * LightSm_state_id_to_string(LightSm_StateId id)
{
    switch (id)
    {
        case LightSm_StateId_ROOT: return "ROOT";
        case LightSm_StateId_FAST_REVERSE: return "FAST_REVERSE";
        case LightSm_StateId_R1: return "R1";
        case LightSm_StateId_R2: return "R2";
        case LightSm_StateId_R3: return "R3";
        case LightSm_StateId_NORMAL: return "NORMAL";
        case LightSm_StateId_OFF: return "OFF";
        case LightSm_StateId_ON1: return "ON1";
        case LightSm_StateId_ON2: return "ON2";
        case LightSm_StateId_ON3: return "ON3";
        default: return "?";
    }
}

// Thread safe.
char const * LightSm_event_id_to_string(LightSm_EventId id)
{
    switch (id)
    {
        case LightSm_EventId_DO: return "DO";
        case LightSm_EventId_KEY_PRESS: return "KEY_PRESS";
        default: return "?";
    }
}
