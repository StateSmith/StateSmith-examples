// Autogenerated with StateSmith 0.10.0-alpha+5d891f5c87fb9c6bf8f44217a56a71a3988f2734.
// Algorithm: Balanced1. See https://github.com/StateSmith/StateSmith/wiki/Algorithms

// License: MIT
// Copyright blah blah blah

#include "LightSm.h"
#include <stdbool.h> // required for `consume_event` flag
#include <string.h> // for memset

// This function is used when StateSmith doesn't know what the active leaf state is at
// compile time due to sub states or when multiple states need to be exited.
static void exit_up_to_state_handler(LightSm* sm, LightSm_Func desired_state_exit_handler);

static void ROOT_enter(LightSm* sm);

static void ROOT_exit(LightSm* sm);

static void OFF_enter(LightSm* sm);

static void OFF_exit(LightSm* sm);

static void OFF_inc(LightSm* sm);

static void OFF_toggle(LightSm* sm);

static void ON_GROUP_enter(LightSm* sm);

static void ON_GROUP_exit(LightSm* sm);

static void ON_GROUP_toggle(LightSm* sm);

static void ON1_enter(LightSm* sm);

static void ON1_exit(LightSm* sm);

static void ON1_dim(LightSm* sm);

static void ON1_inc(LightSm* sm);

static void ON2_enter(LightSm* sm);

static void ON2_exit(LightSm* sm);

static void ON2_dim(LightSm* sm);

static void ON2_inc(LightSm* sm);

static void ON3_enter(LightSm* sm);

static void ON3_exit(LightSm* sm);

static void ON3_dim(LightSm* sm);

static void ON3_inc(LightSm* sm);


// State machine constructor. Must be called before start or dispatch event functions. Not thread safe.
void LightSm_ctor(LightSm* sm)
{
    memset(sm, 0, sizeof(*sm));
}

// Starts the state machine. Must be called before dispatching events. Not thread safe.
void LightSm_start(LightSm* sm)
{
    ROOT_enter(sm);
    // ROOT behavior
    // uml: TransitionTo(ROOT.<InitialState>)
    {
        // Step 1: Exit states until we reach `ROOT` state (Least Common Ancestor for transition). Already at LCA, no exiting required.
        
        // Step 2: Transition action: ``.
        
        // Step 3: Enter/move towards transition target `ROOT.<InitialState>`.
        // ROOT.<InitialState> is a pseudo state and cannot have an `enter` trigger.
        
        // ROOT.<InitialState> behavior
        // uml: TransitionTo(off)
        {
            // Step 1: Exit states until we reach `ROOT` state (Least Common Ancestor for transition). Already at LCA, no exiting required.
            
            // Step 2: Transition action: ``.
            
            // Step 3: Enter/move towards transition target `off`.
            OFF_enter(sm);
            
            // Step 4: complete transition. Ends event dispatch. No other behaviors are checked.
            sm->state_id = LightSm_StateId_OFF;
            // No ancestor handles event. Can skip nulling `ancestor_event_handler`.
            return;
        } // end of behavior for ROOT.<InitialState>
    } // end of behavior for ROOT
}

// Dispatches an event to the state machine. Not thread safe.
void LightSm_dispatch_event(LightSm* sm, LightSm_EventId event_id)
{
    LightSm_Func behavior_func = sm->current_event_handlers[event_id];
    
    while (behavior_func != NULL)
    {
        sm->ancestor_event_handler = NULL;
        behavior_func(sm);
        behavior_func = sm->ancestor_event_handler;
    }
}

// This function is used when StateSmith doesn't know what the active leaf state is at
// compile time due to sub states or when multiple states need to be exited.
static void exit_up_to_state_handler(LightSm* sm, LightSm_Func desired_state_exit_handler)
{
    while (sm->current_state_exit_handler != desired_state_exit_handler)
    {
        sm->current_state_exit_handler(sm);
    }
}


////////////////////////////////////////////////////////////////////////////////
// event handlers for state ROOT
////////////////////////////////////////////////////////////////////////////////

static void ROOT_enter(LightSm* sm)
{
    // setup trigger/event handlers
    sm->current_state_exit_handler = ROOT_exit;
}

static void ROOT_exit(LightSm* sm)
{
    // State machine root is a special case. It cannot be exited. Mark as unused.
    (void)sm;
}


////////////////////////////////////////////////////////////////////////////////
// event handlers for state OFF
////////////////////////////////////////////////////////////////////////////////

static void OFF_enter(LightSm* sm)
{
    // setup trigger/event handlers
    sm->current_state_exit_handler = OFF_exit;
    sm->current_event_handlers[LightSm_EventId_INC] = OFF_inc;
    sm->current_event_handlers[LightSm_EventId_TOGGLE] = OFF_toggle;
    
    // off behavior
    // uml: enter / { leds(0); }
    {
        // Step 1: execute action `leds(0);`
        leds(0);
    } // end of behavior for off
}

static void OFF_exit(LightSm* sm)
{
    // adjust function pointers for this state's exit
    sm->current_state_exit_handler = ROOT_exit;
    sm->current_event_handlers[LightSm_EventId_INC] = NULL;  // no ancestor listens to this event
    sm->current_event_handlers[LightSm_EventId_TOGGLE] = NULL;  // no ancestor listens to this event
}

static void OFF_inc(LightSm* sm)
{
    // No ancestor state handles `inc` event.
    
    // off behavior
    // uml: inc TransitionTo(on1)
    {
        // Step 1: Exit states until we reach `ROOT` state (Least Common Ancestor for transition).
        OFF_exit(sm);
        
        // Step 2: Transition action: ``.
        
        // Step 3: Enter/move towards transition target `on1`.
        ON_GROUP_enter(sm);
        ON1_enter(sm);
        
        // Step 4: complete transition. Ends event dispatch. No other behaviors are checked.
        sm->state_id = LightSm_StateId_ON1;
        // No ancestor handles event. Can skip nulling `ancestor_event_handler`.
        return;
    } // end of behavior for off
}

static void OFF_toggle(LightSm* sm)
{
    // No ancestor state handles `toggle` event.
    
    // off behavior
    // uml: toggle TransitionTo(on_group)
    {
        // Step 1: Exit states until we reach `ROOT` state (Least Common Ancestor for transition).
        OFF_exit(sm);
        
        // Step 2: Transition action: ``.
        
        // Step 3: Enter/move towards transition target `on_group`.
        ON_GROUP_enter(sm);
        
        // on_group.<InitialState> behavior
        // uml: TransitionTo(on_group.<History>)
        {
            // Step 1: Exit states until we reach `on_group` state (Least Common Ancestor for transition). Already at LCA, no exiting required.
            
            // Step 2: Transition action: ``.
            
            // Step 3: Enter/move towards transition target `on_group.<History>`.
            // on_group.<History> is a pseudo state and cannot have an `enter` trigger.
            
            // on_group.<History> behavior
            // uml: [$gil(this.vars.on_group_history == on_group_HistoryId.ON2)] TransitionTo(on2)
            if (sm->vars.on_group_history == LightSm_on_group_HistoryId_ON2)
            {
                // Step 1: Exit states until we reach `on_group` state (Least Common Ancestor for transition). Already at LCA, no exiting required.
                
                // Step 2: Transition action: ``.
                
                // Step 3: Enter/move towards transition target `on2`.
                ON2_enter(sm);
                
                // Step 4: complete transition. Ends event dispatch. No other behaviors are checked.
                sm->state_id = LightSm_StateId_ON2;
                // No ancestor handles event. Can skip nulling `ancestor_event_handler`.
                return;
            } // end of behavior for on_group.<History>
            
            // on_group.<History> behavior
            // uml: [$gil(this.vars.on_group_history == on_group_HistoryId.ON3)] TransitionTo(on3)
            if (sm->vars.on_group_history == LightSm_on_group_HistoryId_ON3)
            {
                // Step 1: Exit states until we reach `on_group` state (Least Common Ancestor for transition). Already at LCA, no exiting required.
                
                // Step 2: Transition action: ``.
                
                // Step 3: Enter/move towards transition target `on3`.
                ON3_enter(sm);
                
                // Step 4: complete transition. Ends event dispatch. No other behaviors are checked.
                sm->state_id = LightSm_StateId_ON3;
                // No ancestor handles event. Can skip nulling `ancestor_event_handler`.
                return;
            } // end of behavior for on_group.<History>
            
            // on_group.<History> behavior
            // uml: else TransitionTo(on1)
            {
                // Step 1: Exit states until we reach `on_group` state (Least Common Ancestor for transition). Already at LCA, no exiting required.
                
                // Step 2: Transition action: ``.
                
                // Step 3: Enter/move towards transition target `on1`.
                ON1_enter(sm);
                
                // Step 4: complete transition. Ends event dispatch. No other behaviors are checked.
                sm->state_id = LightSm_StateId_ON1;
                // No ancestor handles event. Can skip nulling `ancestor_event_handler`.
                return;
            } // end of behavior for on_group.<History>
        } // end of behavior for on_group.<InitialState>
    } // end of behavior for off
}


////////////////////////////////////////////////////////////////////////////////
// event handlers for state ON_GROUP
////////////////////////////////////////////////////////////////////////////////

static void ON_GROUP_enter(LightSm* sm)
{
    // setup trigger/event handlers
    sm->current_state_exit_handler = ON_GROUP_exit;
    sm->current_event_handlers[LightSm_EventId_TOGGLE] = ON_GROUP_toggle;
}

static void ON_GROUP_exit(LightSm* sm)
{
    // adjust function pointers for this state's exit
    sm->current_state_exit_handler = ROOT_exit;
    sm->current_event_handlers[LightSm_EventId_TOGGLE] = NULL;  // no ancestor listens to this event
}

static void ON_GROUP_toggle(LightSm* sm)
{
    // No ancestor state handles `toggle` event.
    
    // on_group behavior
    // uml: toggle TransitionTo(off)
    {
        // Step 1: Exit states until we reach `ROOT` state (Least Common Ancestor for transition).
        exit_up_to_state_handler(sm, ROOT_exit);
        
        // Step 2: Transition action: ``.
        
        // Step 3: Enter/move towards transition target `off`.
        OFF_enter(sm);
        
        // Step 4: complete transition. Ends event dispatch. No other behaviors are checked.
        sm->state_id = LightSm_StateId_OFF;
        // No ancestor handles event. Can skip nulling `ancestor_event_handler`.
        return;
    } // end of behavior for on_group
}


////////////////////////////////////////////////////////////////////////////////
// event handlers for state ON1
////////////////////////////////////////////////////////////////////////////////

static void ON1_enter(LightSm* sm)
{
    // setup trigger/event handlers
    sm->current_state_exit_handler = ON1_exit;
    sm->current_event_handlers[LightSm_EventId_DIM] = ON1_dim;
    sm->current_event_handlers[LightSm_EventId_INC] = ON1_inc;
    
    // on1 behavior
    // uml: enter / { leds(1); }
    {
        // Step 1: execute action `leds(1);`
        leds(1);
    } // end of behavior for on1
    
    // on1 behavior
    // uml: enter / { $gil(this.vars.on_group_history = on_group_HistoryId.ON1;) }
    {
        // Step 1: execute action `$gil(this.vars.on_group_history = on_group_HistoryId.ON1;)`
        sm->vars.on_group_history = LightSm_on_group_HistoryId_ON1;
    } // end of behavior for on1
}

static void ON1_exit(LightSm* sm)
{
    // adjust function pointers for this state's exit
    sm->current_state_exit_handler = ON_GROUP_exit;
    sm->current_event_handlers[LightSm_EventId_DIM] = NULL;  // no ancestor listens to this event
    sm->current_event_handlers[LightSm_EventId_INC] = NULL;  // no ancestor listens to this event
}

static void ON1_dim(LightSm* sm)
{
    // No ancestor state handles `dim` event.
    
    // on1 behavior
    // uml: dim TransitionTo(off)
    {
        // Step 1: Exit states until we reach `ROOT` state (Least Common Ancestor for transition).
        exit_up_to_state_handler(sm, ROOT_exit);
        
        // Step 2: Transition action: ``.
        
        // Step 3: Enter/move towards transition target `off`.
        OFF_enter(sm);
        
        // Step 4: complete transition. Ends event dispatch. No other behaviors are checked.
        sm->state_id = LightSm_StateId_OFF;
        // No ancestor handles event. Can skip nulling `ancestor_event_handler`.
        return;
    } // end of behavior for on1
}

static void ON1_inc(LightSm* sm)
{
    // No ancestor state handles `inc` event.
    
    // on1 behavior
    // uml: inc TransitionTo(on2)
    {
        // Step 1: Exit states until we reach `on_group` state (Least Common Ancestor for transition).
        ON1_exit(sm);
        
        // Step 2: Transition action: ``.
        
        // Step 3: Enter/move towards transition target `on2`.
        ON2_enter(sm);
        
        // Step 4: complete transition. Ends event dispatch. No other behaviors are checked.
        sm->state_id = LightSm_StateId_ON2;
        // No ancestor handles event. Can skip nulling `ancestor_event_handler`.
        return;
    } // end of behavior for on1
}


////////////////////////////////////////////////////////////////////////////////
// event handlers for state ON2
////////////////////////////////////////////////////////////////////////////////

static void ON2_enter(LightSm* sm)
{
    // setup trigger/event handlers
    sm->current_state_exit_handler = ON2_exit;
    sm->current_event_handlers[LightSm_EventId_DIM] = ON2_dim;
    sm->current_event_handlers[LightSm_EventId_INC] = ON2_inc;
    
    // on2 behavior
    // uml: enter / { leds(2); }
    {
        // Step 1: execute action `leds(2);`
        leds(2);
    } // end of behavior for on2
    
    // on2 behavior
    // uml: enter / { $gil(this.vars.on_group_history = on_group_HistoryId.ON2;) }
    {
        // Step 1: execute action `$gil(this.vars.on_group_history = on_group_HistoryId.ON2;)`
        sm->vars.on_group_history = LightSm_on_group_HistoryId_ON2;
    } // end of behavior for on2
}

static void ON2_exit(LightSm* sm)
{
    // adjust function pointers for this state's exit
    sm->current_state_exit_handler = ON_GROUP_exit;
    sm->current_event_handlers[LightSm_EventId_DIM] = NULL;  // no ancestor listens to this event
    sm->current_event_handlers[LightSm_EventId_INC] = NULL;  // no ancestor listens to this event
}

static void ON2_dim(LightSm* sm)
{
    // No ancestor state handles `dim` event.
    
    // on2 behavior
    // uml: dim TransitionTo(on1)
    {
        // Step 1: Exit states until we reach `on_group` state (Least Common Ancestor for transition).
        ON2_exit(sm);
        
        // Step 2: Transition action: ``.
        
        // Step 3: Enter/move towards transition target `on1`.
        ON1_enter(sm);
        
        // Step 4: complete transition. Ends event dispatch. No other behaviors are checked.
        sm->state_id = LightSm_StateId_ON1;
        // No ancestor handles event. Can skip nulling `ancestor_event_handler`.
        return;
    } // end of behavior for on2
}

static void ON2_inc(LightSm* sm)
{
    // No ancestor state handles `inc` event.
    
    // on2 behavior
    // uml: inc TransitionTo(on3)
    {
        // Step 1: Exit states until we reach `on_group` state (Least Common Ancestor for transition).
        ON2_exit(sm);
        
        // Step 2: Transition action: ``.
        
        // Step 3: Enter/move towards transition target `on3`.
        ON3_enter(sm);
        
        // Step 4: complete transition. Ends event dispatch. No other behaviors are checked.
        sm->state_id = LightSm_StateId_ON3;
        // No ancestor handles event. Can skip nulling `ancestor_event_handler`.
        return;
    } // end of behavior for on2
}


////////////////////////////////////////////////////////////////////////////////
// event handlers for state ON3
////////////////////////////////////////////////////////////////////////////////

static void ON3_enter(LightSm* sm)
{
    // setup trigger/event handlers
    sm->current_state_exit_handler = ON3_exit;
    sm->current_event_handlers[LightSm_EventId_DIM] = ON3_dim;
    sm->current_event_handlers[LightSm_EventId_INC] = ON3_inc;
    
    // on3 behavior
    // uml: enter / { leds(3); }
    {
        // Step 1: execute action `leds(3);`
        leds(3);
    } // end of behavior for on3
    
    // on3 behavior
    // uml: enter / { count = 0; }
    {
        // Step 1: execute action `count = 0;`
        count = 0;
    } // end of behavior for on3
    
    // on3 behavior
    // uml: enter / { $gil(this.vars.on_group_history = on_group_HistoryId.ON3;) }
    {
        // Step 1: execute action `$gil(this.vars.on_group_history = on_group_HistoryId.ON3;)`
        sm->vars.on_group_history = LightSm_on_group_HistoryId_ON3;
    } // end of behavior for on3
}

static void ON3_exit(LightSm* sm)
{
    // adjust function pointers for this state's exit
    sm->current_state_exit_handler = ON_GROUP_exit;
    sm->current_event_handlers[LightSm_EventId_DIM] = NULL;  // no ancestor listens to this event
    sm->current_event_handlers[LightSm_EventId_INC] = NULL;  // no ancestor listens to this event
}

static void ON3_dim(LightSm* sm)
{
    // No ancestor state handles `dim` event.
    
    // on3 behavior
    // uml: dim TransitionTo(on2)
    {
        // Step 1: Exit states until we reach `on_group` state (Least Common Ancestor for transition).
        ON3_exit(sm);
        
        // Step 2: Transition action: ``.
        
        // Step 3: Enter/move towards transition target `on2`.
        ON2_enter(sm);
        
        // Step 4: complete transition. Ends event dispatch. No other behaviors are checked.
        sm->state_id = LightSm_StateId_ON2;
        // No ancestor handles event. Can skip nulling `ancestor_event_handler`.
        return;
    } // end of behavior for on3
}

static void ON3_inc(LightSm* sm)
{
    // No ancestor state handles `inc` event.
    
    // on3 behavior
    // uml: 1. inc / { count++; }
    {
        // Step 1: execute action `count++;`
        count++;
        
        // Step 2: determine if ancestor gets to handle event next.
        // No ancestor handles event. Can skip nulling `ancestor_event_handler`.
    } // end of behavior for on3
    
    // on3 behavior
    // uml: 2. inc [count >= 3] TransitionTo(off)
    if (count >= 3)
    {
        // Step 1: Exit states until we reach `ROOT` state (Least Common Ancestor for transition).
        exit_up_to_state_handler(sm, ROOT_exit);
        
        // Step 2: Transition action: ``.
        
        // Step 3: Enter/move towards transition target `off`.
        OFF_enter(sm);
        
        // Step 4: complete transition. Ends event dispatch. No other behaviors are checked.
        sm->state_id = LightSm_StateId_OFF;
        // No ancestor handles event. Can skip nulling `ancestor_event_handler`.
        return;
    } // end of behavior for on3
}

// Thread safe.
char const * LightSm_state_id_to_string(LightSm_StateId id)
{
    switch (id)
    {
        case LightSm_StateId_ROOT: return "ROOT";
        case LightSm_StateId_OFF: return "OFF";
        case LightSm_StateId_ON_GROUP: return "ON_GROUP";
        case LightSm_StateId_ON1: return "ON1";
        case LightSm_StateId_ON2: return "ON2";
        case LightSm_StateId_ON3: return "ON3";
        default: return "?";
    }
}

// Thread safe.
char const * LightSm_event_id_to_string(LightSm_EventId id)
{
    switch (id)
    {
        case LightSm_EventId_DIM: return "DIM";
        case LightSm_EventId_INC: return "INC";
        case LightSm_EventId_TOGGLE: return "TOGGLE";
        default: return "?";
    }
}
